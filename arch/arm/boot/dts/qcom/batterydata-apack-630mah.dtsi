/*
 * Copyright (c) 2015, The Linux Foundation. All rights reserved.
 *
 * This program is free software; you can redistribute it and/or modify
 * it under the terms of the GNU General Public License version 2 and
 * only version 2 as published by the Free Software Foundation.
 *
 * This program is distributed in the hope that it will be useful,
 * but WITHOUT ANY WARRANTY; without even the implied warranty of
 * MERCHANTABILITY or FITNESS FOR A PARTICULAR PURPOSE.  See the
 * GNU General Public License for more details.
 */

qcom,apack-630mah {
	qcom,max-voltage-uv = <4350000>;
	qcom,nom-batt-capacity-mah = <630>;
	qcom,batt-id-kohm = <240>;
	qcom,battery-beta = <3435>;
	qcom,battery-type = "apack-630mah";
	qcom,chg-rslow-comp-c1 = <1063817>;
	qcom,chg-rslow-comp-c2 = <1397278>;
	qcom,chg-rs-to-rslow = <899640>;
	qcom,chg-rslow-comp-thr = <0x9F>;
	qcom,checksum = <0x940D>;
	qcom,gui-version = "PMI8950GUI - 2.0.0.16";
	qcom,fg-profile-data = [
		 34 88 BD 84 
		 1D 88 6A 7E 
		 48 83 0E 6A 
		 D3 68 5A 74 
		 82 82 12 92 
		 CE AE 0E BA 
		 6A 0E 16 88 
		 20 7F 91 82 
		 F3 7C 53 83 
		 98 69 54 78 
		 F0 84 6F 82 
		 79 93 DC B4 
		 3F C0 5E 13 
		 B2 02 40 63 
		 CE 6E AD FF 
		 17 3C D1 45 
		 07 39 00 00 
		 69 4C 6C 38 
		 97 38 00 00 
		 00 00 00 00 
		 00 00 00 00 
		 94 70 F1 71 
		 3D 3F 64 81 
		 5C 6F 97 60 
		 99 61 1F 7A 
		 1C 6D B4 34 
		 45 80 CE C1 
		 0F 4C 68 4D 
		 65 A0 71 0C 
		 28 00 FF 36 
		 F0 11 30 03 
		 00 00 00 0C 
	];
};
